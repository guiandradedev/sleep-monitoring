## esp/main/Kconfig
```kconfig
menu "Wi-Fi Settings"

config WIFI_SSID
    string "Wi-Fi SSID"
    default ""

config WIFI_PASSWORD
    string "Wi-Fi Password"
    default ""

config WEBSOCKET_URI
    string "WebSocket URI"
    default ""

endmenu
```

## esp/sdkconfig.defaults.example
```kconfig
CONFIG_WIFI_SSID="ssid"
CONFIG_WIFI_PASSWORD="senha"
CONFIG_WEBSOCKET_URI="ws://ip:8080/ws"
```
